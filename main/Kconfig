## main/Kconfig
```kconfig
menu "Probe WiFi Configuration"

config PROBE_DEVICE_NAME
    string "probe1"
    default "probe1"

config PROBE_WIFI_SSID
    string "WiFi SSID"
    default "MY_WIFI_SSID"

config PROBE_WIFI_PASS
    string "WiFi Password"
    default "MY_WIFI_PASS"

config PROBE_NTP_SERVER
    string "NTP server URI"
    default "pool.ntp.org"

config PROBE_NTP_UTC_OFFSET_MINUTES
    int "UTC offset in minutes"
    default 180

config PROBE_MQTT_BROKER_URI
    string "MQTT brocker URI"
    default "192.168.7.77"

config PROBE_MQTT_BROKER_TOPIC_PREFIX
    string "Prefix for MQTT message"
    default "sl"

config PROBE_MQTT_BROKER_USERNAME
    string "MQTT brocker username"
    default "admin"

config PROBE_MQTT_BROKER_PASSWORD
    string "MQTT brocker password"
    default "mqttadminpassword"

config PROBE_EMULATE_UART
    bool "Emulate UART with mock data"
    default n
    help
        If enabled, probe will use mock data instead of reading real UART.

endmenu
```

## sdkconfig.defaults
```kconfig
CONFIG_PROBE_WIFI_SSID="Olzadia Lab"
CONFIG_PROBE_WIFI_PASS="Pu"
CONFIG_WIFI_PROV_SCAN_MAX_ENTRIES 10

CONFIG_PROBE_NTP_SERVER="pool.ntp.org"
CONFIG_PROBE_NTP_UTC_OFFSET_MINUTES=180
CONFIG_PROBE_MQTT_BROKER_URI="192.168.7.77"
```

## sdkconfig.defaults.example
```kconfig
# rename it as sdkconfig.defaults and call
# idf.py reconfigure

CONFIG_PROBE_WIFI_SSID="YOUR_WIFI_SSID"
CONFIG_PROBE_WIFI_PASS="YOUR_WIFI_PASSWORD"
CONFIG_WIFI_PROV_SCAN_MAX_ENTRIES=10

CONFIG_PROBE_NTP_SERVER="pool.ntp.org"
CONFIG_PROBE_NTP_UTC_OFFSET_MINUTES=180
CONFIG_PROBE_MQTT_BROKER_URI="192.168.7.77"

CONFIG_PROBE_EMULATE_UART=true
```
